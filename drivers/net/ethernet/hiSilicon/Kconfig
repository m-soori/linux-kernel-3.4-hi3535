## drivers/net/ethernet/hiSilicon/Kconfig
```kconfig
menuconfig HiMAC_ETH_TNK
	tristate "HiSilicon 10/100/1000 Ethernet driver, TNK added"
	select MII
	select PHYLIB
	select CRC32
	depends on NETDEVICES && HAS_IOMEM && (ARCH_HI3535)
	help
	  This is the driver for the Ethernet IPs are built around a
	  Synopsys IP Core and only tested on the HiSilicon
	  platforms.

if HiMAC_ETH_TNK

config HiMAC_DA
	bool "HiMAC DMA arbitration scheme"
	default n
	help
	  Selecting this option, rx has priority over Tx (only for Giga
	  Ethernet device).
	  By default, the DMA arbitration scheme is based on Round-robin
	  (rx:tx priority is 1:1).

config HiMAC_DUAL_MAC
	bool "HiMAC: dual mac support"
	default y if ARCH_HI3535
        depends on HiMAC_ETH_TNK
	help
	  The Huawei Hi3521 soCs has only one Ethernet Controllers.
	  The Huawei Hi35XX SoCs may have two Ethernet Controllers.
	  This option turns on the second Ethernet device
	  if required.

config HiMAC_TIMER
	bool "HiMAC Timer optimisation"
	default n
	depends on RTC_HCTOSYS_DEVICE
	help
	  Use an external timer for mitigating the number of network
	  interrupts. Currently, for SH architectures, it is possible
	  to use the TMU channel 2 and the SH-RTC device.

choice
        prompt "Select Timer device"
        depends on HiMAC_TIMER

config HiMAC_TMU_TIMER_TNK
        bool "TMU channel 2"
        depends on CPU_SH4
	help
	  Use an external timer for mitigating the number
	  of network interrupts. Currently, for SH
	  architectures, it is possible to use the TMU
	  channel 2 device.

config HiMAC_RTC_TIMER_TNK
        bool "Real time clock"
        depends on RTC_CLASS
	help
	  Use an external timer for mitigating the number
	  of network interrupts. Currently, for SH
	  architectures, it is possible to use the SH-RTC
	  device.

endchoice

config HiMAC_IOADDR
	hex "HiMAC IO address"
	default "0x12020000" if (ARCH_HI3535)

config HiMAC_IOSIZE
	hex "HiMAC IO size"
	default "0x00020000"

config HiMAC_IRQNUM
	int "HiMAC irq number"
	default "59" if ARCH_HI3535

config HiMAC_SYS_IOADDR
	hex "HiMAC System Config IO address"
	default "0x20030000" if (ARCH_HI3535)

config HiMAC_SYS_IOSIZE
	hex "HiMAC System Config IO size"
	default "0x00000100"

config HiMAC_PHY0_ID
	hex "HiMAC MAC #0 PHY ID"
	default 1 if (ARCH_HI3535)

config HiMAC_PHY1_ID
	hex "HiMAC MAC #1 PHY ID"
	default 2 if (ARCH_HI3535)
	depends on HiMAC_DUAL_MAC

config HiMAC_MDIO_INTERFACE
	hex "HiMAC MDIO INTERFACE"
	default 6 if (ARCH_HI3535)
	depends on HiMAC_ETH_TNK
	help
	Hi35XX support rgmii, rmii, mii interface mode,
	if you use mii mode, please set 1 as default value.
	if you use rmii mode, please set 5 as default value.
	hi35XX use rgmii(6) as default mido interface mode.

	/* Interface Mode definitions */
	typedef enum {
		PHY_INTERFACE_MODE_NA,		/* 0x0 */
		PHY_INTERFACE_MODE_MII,		/* 0x1 */
		PHY_INTERFACE_MODE_GMII,	/* 0x2 */
		PHY_INTERFACE_MODE_SGMII,	/* 0x3 */
		PHY_INTERFACE_MODE_TBI,  	/* 0x4 */
		PHY_INTERFACE_MODE_RMII,	/* 0x5 */
		PHY_INTERFACE_MODE_RGMII,	/* 0x6 */
		PHY_INTERFACE_MODE_RGMII_ID,	/* 0x7 */
		PHY_INTERFACE_MODE_RGMII_RXID,	/* 0x8 */
		PHY_INTERFACE_MODE_RGMII_TXID,	/* 0x9 */
		PHY_INTERFACE_MODE_RTBI,	/* 0xa */
		PHY_INTERFACE_MODE_SMII,	/* 0xb */
	} phy_interface_t;
endif
```
